## Documentation/devicetree/bindings/soc/mediatek/dvfsrc.txt
```
MediaTek DVFSRC

The Dynamic Voltage and Frequency Scaling Resource Collector (DVFSRC) is a
HW module which is used to collect all the requests from both software and
hardware and turn into the decision of minimum operating voltage and minimum
DRAM frequency to fulfill those requests.

Required Properties:
- compatible: Should be one of the following
	- "mediatek,mt8183-dvfsrc": For MT8183 SoC
	- "mediatek,mt6785-dvfsrc": For MT6785 SoC
	- "mediatek,mt6873-dvfsrc": For MT6873 SoC
	- "mediatek,mt6885-dvfsrc": For MT6885 SoC
	- "mediatek,mt6893-dvfsrc": For MT6893 SoC
	- "mediatek,mt6853-dvfsrc": For MT6853 SoC
	- "mediatek,mt6833-dvfsrc": For MT6833 SoC
	- "mediatek,mt6877-dvfsrc": For MT6877 SoC
	- "mediatek,mt6983-dvfsrc": For MT6983 SoC
	- "mediatek,mt6879-dvfsrc": For MT6879 SoC
	- "mediatek,mt6855-dvfsrc": For MT6855 SoC
	- "mediatek,mt6895-dvfsrc": For MT6895 SoC
	- "mediatek,mt6789-dvfsrc": For MT6789 SoC
- reg: Address range of the DVFSRC unit
- reg-names: Required name for the reg resource ("dvfsrc")
- #interconnect-cells : should contain 1

Example:

	dvfsrc@10012000 {
		compatible = "mediatek,mt8183-dvfsrc";
		reg = <0 0x10012000 0 0x1000>;
		clocks = <&infracfg CLK_INFRA_DVFSRC>;
		clock-names = "dvfsrc";
		ddr_emi: interconnect {
			compatible = "mediatek,mt8183-emi";
			#interconnect-cells = <1>;
		};
		dvfsrc-regulator {
			compatible = "mediatek,mt8183-dvfsrc-regulator";
			dvfsrc_vcore: dvfsrc-vcore {
				regulator-name = "dvfsrc-vcore";
				regulator-min-microvolt = <725000>;
				regulator-max-microvolt = <800000>;
				regulator-always-on;
			};
		};
	};
```

## arch/arm64/configs/rosemary_defconfig
```kconfig
CONFIG_CMDLINE="console=tty0 console=ttyMT3,921600n1 root=/dev/ram vmalloc=496M slub_max_order=0 slub_debug=O"
CONFIG_LOCALVERSION="-Genesis"
# CONFIG_LOCALVERSION_AUTO is not set
CONFIG_SYSVIPC=y
CONFIG_POSIX_MQUEUE=y
CONFIG_AUDIT=y
CONFIG_NO_HZ_IDLE=y
CONFIG_HIGH_RES_TIMERS=y
CONFIG_PREEMPT=y
CONFIG_IRQ_TIME_ACCOUNTING=y
CONFIG_IKCONFIG=y
CONFIG_IKCONFIG_PROC=y
CONFIG_IKHEADERS=y
CONFIG_LOG_BUF_SHIFT=21
CONFIG_UCLAMP_TASK=y
CONFIG_MEMCG=y
CONFIG_BLK_CGROUP=y
CONFIG_UCLAMP_TASK_GROUP=y
CONFIG_CGROUP_PIDS=y
CONFIG_CPUSETS=y
CONFIG_CGROUP_DEVICE=y
CONFIG_CGROUP_CPUACCT=y
CONFIG_USER_NS=y
CONFIG_SCHED_AUTOGROUP=y
CONFIG_BLK_DEV_INITRD=y
CONFIG_BPF_SYSCALL=y
CONFIG_ARCH_MEDIATEK=y
CONFIG_ARM64_VA_BITS_48=y
CONFIG_SCHED_MC=y
CONFIG_NR_CPUS=8
CONFIG_COMPAT=y
CONFIG_WQ_POWER_EFFICIENT_DEFAULT=y
CONFIG_ENERGY_MODEL=y
CONFIG_CPU_FREQ=y
CONFIG_CPU_FREQ_STAT=y
CONFIG_CPU_FREQ_GOV_POWERSAVE=y
CONFIG_CPU_FREQ_GOV_USERSPACE=y
CONFIG_CPU_FREQ_GOV_ONDEMAND=y
CONFIG_BLK_INLINE_ENCRYPTION=y
CONFIG_BLK_INLINE_ENCRYPTION_FALLBACK=y
CONFIG_ZSMALLOC=y
CONFIG_NET=y
CONFIG_INET=y
CONFIG_SYN_COOKIES=y
CONFIG_NETFILTER=y
CONFIG_NF_CONNTRACK=y
CONFIG_NF_CONNTRACK_PROCFS=y
CONFIG_VLAN_8021Q=y
CONFIG_CFG80211=y
CONFIG_NL80211_TESTMODE=y
# CONFIG_CFG80211_DEFAULT_PS is not set
CONFIG_ZRAM=y
CONFIG_MTK_PLATFORM="mt6785"
CONFIG_ARCH_MTK_PROJECT="rosemary"
CONFIG_MTK_CM_MGR_LEGACY=y
CONFIG_MTK_PTPOD=y
CONFIG_MTK_STATIC_POWER=y
CONFIG_MTK_UNIFY_POWER=y
CONFIG_MTK_PBM=y
CONFIG_MTK_CAMERA_ISP_SUPPORT=y
CONFIG_MTK_CAMERA_RSC_ISP6S=y
CONFIG_MTK_CAMERA_WPE_ISP6S=y
CONFIG_MTK_CAMERA_DPE_ISP6S=y
CONFIG_MTK_CAMERA_MFB_ISP6S=y
CONFIG_MTK_CAMERA_FD_ISP6S=y
CONFIG_MTK_CAMERA_DIP_ISP6S=y
CONFIG_MTK_CMDQ_MBOX_EXT=y
CONFIG_MTK_LENS=y
CONFIG_MTK_FLASHLIGHT=y
CONFIG_MTK_FLASHLIGHT_DLPT=y
CONFIG_MTK_IMGSENSOR=y
CONFIG_CUSTOM_KERNEL_IMGSENSOR="ov64b40semco_mipi_raw ov64b40ofilm_mipi_raw ov13b10sunny_mipi_raw ov13b10ofilm_mipi_raw imx355ofilm_mipi_raw imx355sunny_mipi_raw ov02b1bofilm_mipi_raw gc02m1ofilm_mipi_raw gc02m1sunny_mipi_raw gc02m1bsunny_mipi_mono"
CONFIG_MTK_JPEG=y
CONFIG_MTK_CAM_CAL=y
CONFIG_MTK_CCU=y
CONFIG_MTK_SCP_AUDIO=m
CONFIG_MTK_VOW_SUPPORT=y
CONFIG_MTK_VOW_DSP_VERSION="ver01"
CONFIG_HAVE_MTK_ENABLE_GENIEZONE=y
CONFIG_MTK_ENABLE_GENIEZONE=y
CONFIG_MTK_GZ_MAIN=y
CONFIG_MTK_GZ_LOG=y
CONFIG_MTK_GZ_VIRTIO=y
CONFIG_MTK_GZ_VIRTIO_IPC=y
CONFIG_MTK_GZ_IRQ=y
CONFIG_HAVE_MTK_GZ_LOG=y
CONFIG_MTK_APUSYS_MDLA_SUPPORT=y
CONFIG_MTK_VPU_SUPPORT=y
CONFIG_MTK_TINYSYS_SSPM_SUPPORT=y
CONFIG_MTK_TINYSYS_SCP_SUPPORT=y
CONFIG_MTK_TINYSYS_SCP_LOGGER_SUPPORT=y
CONFIG_MTPROF=y
CONFIG_MTK_SDA=y
CONFIG_MTK_IRQ_DBG=y
CONFIG_MTK_DRAM_LOG_STORE=y
CONFIG_MTK_DRAM_LOG_STORE_ADDR=0x0011DF00
CONFIG_MTK_DRAM_LOG_STORE_SIZE=0x100
CONFIG_MTK_SELINUX_AEE_WARNING=y
CONFIG_MTK_CCCI_DEVICES=y
CONFIG_MTK_MD1_SUPPORT=12
CONFIG_MTK_ECCCI_DRIVER=y
CONFIG_MTK_ECCCI_C2K=y
CONFIG_MTK_BTIF=y
CONFIG_MTK_COMBO=y
CONFIG_MTK_COMBO_BT=y
CONFIG_MTK_COMBO_GPS=y
CONFIG_MTK_COMBO_WIFI=y
CONFIG_MTK_DHCPV6C_WIFI=y
CONFIG_MTK_GPS_SUPPORT=y
CONFIG_MTK_FMRADIO=y
CONFIG_MTK_FM_CHIP="MT6631_FM"
CONFIG_MTK_CONNSYS_DEDICATED_LOG_PATH=y
CONFIG_NFC_CHIP_SUPPORT=y
CONFIG_TCPC_CLASS=y
CONFIG_USB_POWER_DELIVERY=y
CONFIG_TCPC_MT6360=y
CONFIG_MTK_TYPEC_WATER_DETECT=y
CONFIG_MTK_TYPEC_WATER_DETECT_BY_PCB=y
CONFIG_EXTCON_MTK_USB=y
CONFIG_USB=y
CONFIG_USB_XHCI_HCD=y
CONFIG_USB_GADGET=y
CONFIG_USB_MTU3=y
CONFIG_USB_MTK_HDRC=y
CONFIG_USB_MTK_OTG=y
CONFIG_USB_TRANCEVIBRATOR=y
CONFIG_MTK_USB_META=y
CONFIG_USB_CONFIGFS=y
CONFIG_USB_CONFIGFS_UEVENT=y
CONFIG_USB_CONFIGFS_SERIAL=y
CONFIG_USB_CONFIGFS_ACM=y
CONFIG_USB_CONFIGFS_NCM=y
CONFIG_USB_CONFIGFS_ECM=y
CONFIG_USB_CONFIGFS_RNDIS=y
CONFIG_USB_CONFIGFS_MASS_STORAGE=y
CONFIG_USB_CONFIGFS_F_FS=y
CONFIG_MTK_COMBO_CHIP_CONSYS_6785=y
CONFIG_MTK_CLK_BUFFER=y
CONFIG_MTK_CLKBUF=y
CONFIG_MTK_CLKBUF_V1=y
CONFIG_MTK_CLKBUF_NFC=y
CONFIG_MTK_MET=y
CONFIG_MTK_MET_PLF=y
CONFIG_MTK_AURISYS_PHONE_CALL_SUPPORT=y
CONFIG_MTK_CONNFEM=y
CONFIG_MTK_AUDIODSP_SUPPORT=y
CONFIG_MTK_ADSP_V2=y
CONFIG_MTK_PWM=y
CONFIG_MTK_VIBRATOR=y
CONFIG_AW8622_HAPTIC=y
CONFIG_MTK_LEDS=y
CONFIG_MTK_ACCDET=y
CONFIG_ACCDET_EINT_IRQ=y
CONFIG_ACCDET_SUPPORT_EINT0=y
CONFIG_MTK_SENSOR_SUPPORT=y
CONFIG_MTK_HWMON=y
CONFIG_CUSTOM_KERNEL_SENSORHUB=y
CONFIG_CUSTOM_KERNEL_ACCELEROMETER=y
CONFIG_MTK_ACCELHUB=y
CONFIG_CUSTOM_KERNEL_ALSPS=y
CONFIG_MTK_ALSPSHUB=y
CONFIG_CUSTOM_KERNEL_GYROSCOPE=y
CONFIG_MTK_GYROHUB=y
CONFIG_CUSTOM_KERNEL_MAGNETOMETER=y
CONFIG_MTK_MAGHUB=y
CONFIG_CUSTOM_KERNEL_BAROMETER=y
CONFIG_MTK_BAROHUB=y
CONFIG_CUSTOM_KERNEL_STEP_COUNTER=y
CONFIG_MTK_STEPSIGNHUB=y
CONFIG_CUSTOM_KERNEL_SITUATION=y
CONFIG_MTK_LIGHTSECONDARY_HUB=y
CONFIG_MTK_GLGHUB=y
CONFIG_MTK_PICKUPHUB=y
CONFIG_MTK_WAKEHUB=y
CONFIG_MTK_STATHUB=y
CONFIG_MTK_MOTION_DETECT_HUB=y
CONFIG_MTK_DEVICE_ORIENTATION_HUB=y
CONFIG_MTK_TILTDETECTHUB=y
CONFIG_MTK_SAR_HUB=y
CONFIG_CUSTOM_KERNEL_SENSOR_FUSION=y
CONFIG_CUSTOM_KERNEL_GRV_SENSOR=y
CONFIG_CUSTOM_KERNEL_GMRV_SENSOR=y
CONFIG_CUSTOM_KERNEL_RV_SENSOR=y
CONFIG_CUSTOM_KERNEL_LINEARACCEL_SENSOR=y
CONFIG_CUSTOM_KERNEL_GRAVITY_SENSOR=y
CONFIG_CUSTOM_KERNEL_UNCALI_ACC_SENSOR=y
CONFIG_CUSTOM_KERNEL_UNCALI_GYRO_SENSOR=y
CONFIG_CUSTOM_KERNEL_UNCALI_MAG_SENSOR=y
CONFIG_MTK_UNCALI_MAGHUB=y
CONFIG_MTK_UNCALI_GYROHUB=y
CONFIG_MTK_UNCALI_ACCHUB=y
CONFIG_CUSTOM_KERNEL_SENSOR_CAL=y
CONFIG_NANOHUB=y
CONFIG_NANOHUB_MTK_IPI=y
CONFIG_MTK_SCHEDULER=y
CONFIG_MTK_EAS=y
CONFIG_MTK_NEWIDLE_BALANCE=y
CONFIG_MTK_CORE_PAUSE=y
CONFIG_MTK_SCHED_BIG_TASK_ROTATE=y
CONFIG_MTK_CPUFREQ_SUGOV_EXT=y
CONFIG_MTK_FPSGO_V3=y
CONFIG_MTK_LOAD_TRACKER=y
CONFIG_MTK_PERF_COMMON=y
CONFIG_MTK_PERF_TRACKER=y
CONFIG_SCSI=y
CONFIG_BLK_DEV_SD=y
CONFIG_SCSI_UFSHCD=y
CONFIG_SCSI_UFSHCD_PLATFORM=y
CONFIG_SCSI_UFS_MEDIATEK=y
CONFIG_SCSI_UFS_CRYPTO=y
CONFIG_SCSI_UFS_HPB=y
CONFIG_KEYBOARD_MTK_KPD=y
CONFIG_INPUT_TOUCHSCREEN=y
CONFIG_TOUCHSCREEN_FTS=y
CONFIG_TOUCHSCREEN_FTS_DIRECTORY="ft3418_i2c"
CONFIG_TOUCHSCREEN_XIAOMI_TOUCHFEATURE=y
CONFIG_TOUCHSCREEN_GOODIX_GTX8=y
CONFIG_TOUCHSCREEN_COMMON=y
CONFIG_TOUCHSCREEN_MTK_TOUCH="ft3418_i2c xiaomi"
CONFIG_MTK_FINGERPRINT_SUPPORT=y
CONFIG_MTK_FINGERPRINT_SELECT="NA"
CONFIG_FPC_FINGERPRINT=y
CONFIG_GOODIX_FINGERPRINT=y
CONFIG_SERIAL_8250=y
CONFIG_SERIAL_8250_CONSOLE=y
CONFIG_SERIAL_8250_NR_UARTS=2
CONFIG_SERIAL_8250_RUNTIME_UARTS=2
CONFIG_SERIAL_8250_MT6577=y
CONFIG_I2C=y
CONFIG_SPI=y
CONFIG_SPI_MT65XX=y
# CONFIG_PINCTRL_MT2712 is not set
CONFIG_PINCTRL_MT6785=y
# CONFIG_PINCTRL_MT7622 is not set
# CONFIG_PINCTRL_MT8167 is not set
# CONFIG_PINCTRL_MT8173 is not set
# CONFIG_PINCTRL_MT8516 is not set
CONFIG_MTK_CHARGER=y
CONFIG_MTK_CHARGER_TYPE_DETECT=y
CONFIG_MTK_KERNEL_POWER_OFF_CHARGING=y
CONFIG_BQ2597X_CHARGE_PUMP=y
CONFIG_LN8000_CHARGE_PUMP=y
CONFIG_BATTERY_MAX1721X=y
CONFIG_BATT_VERIFY_BY_DS28E16=y
CONFIG_ONEWIRE_GPIO=y
CONFIG_THERMAL=y
CONFIG_MTK_THERMAL=y
CONFIG_MTK_THERMAL_INTERFACE=y
CONFIG_MEDIA_SUPPORT=y
# CONFIG_MEDIA_SUPPORT_FILTER is not set
CONFIG_V4L_PLATFORM_DRIVERS=y
CONFIG_V4L_MEM2MEM_DRIVERS=y
CONFIG_VIDEO_MEDIATEK_VPU=y
CONFIG_VIDEO_MEDIATEK_VCODEC=y
CONFIG_VIDEO_MEDIATEK_VCODEC_V2=y
CONFIG_MTK_LOW_POWER_MODULE=y
CONFIG_INTERCONNECT_MTK=y
CONFIG_INTERCONNECT_MTK_EMI=y
CONFIG_INTERCONNECT_MTK_EXTENSION=y
CONFIG_DRM=y
CONFIG_DRM_MEDIATEK=y
CONFIG_DRM_MEDIATEK_V2=y
CONFIG_DRM_MIPI_DSI=y
CONFIG_MTK_DISP_LOGGER=y
CONFIG_MTK_AAL_SUPPORT=y
CONFIG_MTK_DRE30_SUPPORT=y
CONFIG_MTK_GPU_SUPPORT=y
CONFIG_MTK_GPU_VERSION="mali valhall r32p1"
CONFIG_MTK_GPU_COMMON_DVFS_SUPPORT=y
CONFIG_SOUND=y
CONFIG_SND=y
CONFIG_SND_HRTIMER=y
CONFIG_SND_DYNAMIC_MINORS=y
CONFIG_SND_VERBOSE_PRINTK=y
CONFIG_SND_DEBUG=y
CONFIG_SND_DEBUG_VERBOSE=y
CONFIG_SND_PCM_XRUN_DEBUG=y
CONFIG_SND_SEQUENCER=y
CONFIG_SND_SEQ_DUMMY=y
CONFIG_SND_SOC=y
CONFIG_SND_SOC_MT6785=y
CONFIG_SND_SOC_MT6785_MT6359=y
CONFIG_SND_SOC_MTK_BTCVSD=y
CONFIG_SND_SOC_MTK_AUDIO_DSP=y
CONFIG_MTK_AUDIO_IPI=y
CONFIG_MTK_ULTRASND_PROXIMITY=y
CONFIG_SND_SOC_DSPK_LOL_HP=y
CONFIG_SND_SOC_AW87XXX=y
CONFIG_HIDRAW=y
CONFIG_MMC=y
CONFIG_MMC_BLOCK_MINORS=32
CONFIG_MMC_MTK=y
CONFIG_NEW_LEDS=y
CONFIG_LEDS_CLASS=y
CONFIG_DMADEVICES=y
CONFIG_MTK_UART_APDMA=y
CONFIG_SYNC_FILE=y
CONFIG_DMABUF_HEAPS=y
CONFIG_STAGING=y
CONFIG_ION=y
CONFIG_COMMON_CLK_MTK_FREQ_HOPPING=y
CONFIG_COMMON_CLK_MT6785=y
CONFIG_COMMON_CLK_MTK_FREQ_HOPPING_SSPM=y
CONFIG_MAILBOX=y
CONFIG_MTK_IOMMU=y
CONFIG_REMOTEPROC=y
CONFIG_MTK_SCP=y
CONFIG_RPMSG_MTK=y
CONFIG_RTC_CLASS=y
CONFIG_RTC_SYSTOHC=y
CONFIG_RTC_DRV_MT6358=y
CONFIG_WATCHDOG=y
CONFIG_MEDIATEK_WATCHDOG=y
CONFIG_RANDOMIZE_BASE=y
CONFIG_MFD_MT6360=y
CONFIG_MTK_FLASHLIGHT_PT=y
CONFIG_MTK_FLASHLIGHT_PT_STRICT=y
CONFIG_SND_USB_AUDIO=y
CONFIG_MTK_VOW_BARGE_IN_SUPPORT=y
CONFIG_USB_OTG=y
CONFIG_CPU_FREQ_DEFAULT_GOV_SCHEDUTIL=y
CONFIG_MTK_PMIC_WRAP=y
CONFIG_MTK_IPI=y
CONFIG_MTK_MBOX=y
CONFIG_IIO=y
CONFIG_MEDIATEK_MT6577_AUXADC=y
CONFIG_PHY_MTK_TPHY=y
CONFIG_ANDROID=y
CONFIG_ANDROID_VENDOR_HOOKS=y
CONFIG_TEE=y
CONFIG_MTK_TEE_GP_SUPPORT=y
CONFIG_MICROTRUST_TEE_SUPPORT=y
CONFIG_MTK_SEC_VIDEO_PATH_SUPPORT=y
CONFIG_MTK_SVP_ON_MTEE_SUPPORT=y
CONFIG_MTK_DRM_KEY_MNG_SUPPORT=y
CONFIG_MTK_SECURE_MEM_SUPPORT=y
CONFIG_MTK_WFD_SMEM_SUPPORT=y
CONFIG_MTK_TRUSTED_MEMORY_SUBSYSTEM=y
CONFIG_MTK_WIDEVINE_DRM=y
CONFIG_F2FS_FS=y
CONFIG_F2FS_FS_SECURITY=y
CONFIG_INCREMENTAL_FS=y
CONFIG_ISO9660_FS=y
CONFIG_JOLIET=y
CONFIG_ZISOFS=y
CONFIG_MSDOS_FS=y
CONFIG_VFAT_FS=y
CONFIG_EXFAT_FS=y
CONFIG_PSTORE=y
CONFIG_PSTORE_CONSOLE=y
CONFIG_PSTORE_PMSG=y
CONFIG_PSTORE_RAM=y
CONFIG_EROFS_FS=y
CONFIG_EROFS_FS_PCPU_KTHREAD=y
CONFIG_NLS_CODEPAGE_437=y
CONFIG_NLS_CODEPAGE_950=y
CONFIG_NLS_ASCII=y
CONFIG_NLS_ISO8859_1=y
CONFIG_NLS_UTF8=y
CONFIG_SECURITY=y
CONFIG_SECURITY_NETWORK=y
CONFIG_STATIC_USERMODEHELPER=y
CONFIG_STATIC_USERMODEHELPER_PATH="/system_ext/bin/aee_core_forwarder"
CONFIG_SECURITY_SELINUX=y
CONFIG_CRYPTO_TWOFISH=y
CONFIG_CRC8=y
CONFIG_PRINTK_TIME=y
CONFIG_DYNAMIC_DEBUG=y
CONFIG_FRAME_WARN=3000
CONFIG_PANIC_ON_OOPS=y
CONFIG_RCU_CPU_STALL_TIMEOUT=60
CONFIG_MTK_SCPSYS=y
CONFIG_MTK_DVFSRC=y
CONFIG_REGULATOR_MTK_DVFSRC=y
CONFIG_MTK_DVFSRC_DEVFREQ=y
CONFIG_MTK_DVFSRC_HELPER=y
CONFIG_MTK_DVFSRC_MET=y
CONFIG_REGULATOR_WL2866D=y
CONFIG_FTRACE=y
CONFIG_ENABLE_DEFAULT_TRACERS=y
CONFIG_MTK_LEGACY_THERMAL=y

# P3: Storage security (dm-crypt, dm-verity)
CONFIG_DM_CRYPT=y
CONFIG_DM_DEFAULT_KEY=y
CONFIG_DM_VERITY_FEC=y

# P3: UFS performance
CONFIG_SCSI_UFS_TW=y
CONFIG_SCSI_UFS_TW_IGNORE_GUARANTEE_BIT=y
CONFIG_SCSI_UFS_FEATURE=y
CONFIG_SCSI_SKHPB=y

# P3: Video codec
CONFIG_VIDEO_MEDIATEK_VCU_WO_FUSE=y
```

## drivers/input/touchscreen/xiaomi/Kconfig
```kconfig
config TOUCHSCREEN_XIAOMI_TOUCHFEATURE
	tristate "Xiaomi touch feature"
	default n
	help
	  Say Y here if you want Xiaomi touch feature.

if TOUCHSCREEN_XIAOMI_TOUCHFEATURE

config TOUCHSCREEN_XIAOMI_TOUCHFEATURE_DIRECTORY
	string "Xiaomi touch directory name"
	default "xiaomi"

endif
```

## drivers/misc/mediatek/leds/Kconfig
```kconfig
config MTK_LEDS
	bool "MediaTek LED driver"
	help
	  This selects the MediaTek LED driver.

config LEDS_MT6357
	bool "MT6357 PMIC LED driver"
	depends on MTK_LEDS
	help
	  LED driver for MT6357 PMIC.

config LEDS_MTK_DISP
	bool "MediaTek Display Backlight LED driver"
	depends on MTK_LEDS
	help
	  Backlight LED control via display path.

config LEDS_MTK_PWM
	bool "MediaTek PWM Backlight LED driver"
	depends on MTK_LEDS
	help
	  Backlight LED control via PWM.

config LEDS_MTK_I2C
	bool "MediaTek I2C Backlight LED driver"
	depends on MTK_LEDS
	help
	  Backlight LED control via I2C gate IC.

config BACKLIGHT_SUPPORT_LP8557
	bool "LP8557 backlight I2C"
	depends on LEDS_MTK_I2C

config BACKLIGHT_SUPPORT_LM3697
	bool "LM3697 backlight I2C"
	depends on LEDS_MTK_I2C

config CONTROL_BL_TEMPERATURE
	bool "Brightness thermal control"
	depends on MTK_LEDS

config LIGHTNESS_MAPPING_VALUE
	int "Lightness mapping value"
	depends on MTK_LEDS
	default 100
```

## drivers/misc/mediatek/sensors-1.0/accelerometer/accelhub/Kconfig
```kconfig
config MTK_ACCELHUB
	tristate "accelhub for MediaTek package"
	help
	  It support different accelerometer sensor.
	  If this option is set,
	  it will support
	  sensorhub Accelerometer.
```

## drivers/misc/mediatek/sensors-1.0/alsps/alspshub/Kconfig
```kconfig
config MTK_ALSPSHUB
	tristate "alspshub for MediaTek package"
	help
	  It support different alspshub sensor.
	  If this option is set,
	  it will support
	  sensorhub gyroscope.
```

## drivers/misc/mediatek/sensors-1.0/barometer/barohub/Kconfig
```kconfig
config MTK_BAROHUB
	tristate "barohub for MediaTek package"
	help
	  It support different barohub sensor.
	  If this option is set,
	  it will support
	  sensorhub gyroscope.
```

## drivers/misc/mediatek/sensors-1.0/gyroscope/gyrohub/Kconfig
```kconfig
config MTK_GYROHUB
	tristate "gyrohub for MediaTek package"
	help
	  It support different gyrohub sensor.
	  If this option is set,
	  it will support
	  sensorhub gyroscope.
```

## drivers/misc/mediatek/sensors-1.0/magnetometer/maghub/Kconfig
```kconfig
config MTK_MAGHUB
	tristate "maghub for MediaTek package"
	help
	  It support different maghub sensor.
	  If this option is set,
	  it will support
	  sensorhub gyroscope.
```

## drivers/misc/mediatek/thermal/Kconfig
```kconfig
config MTK_LEGACY_THERMAL
	bool "Use MTK legacy thermal code"
	help
	  Upstream thermal code and legacy thermal
	  code are not compatible. As a result,
	  add a new switch MTK_LEGACY_THERMAL to replace
	  CONFIG_THERMAL for MTK legacy thermal code.

config MTK_THERMAL_PA_VIA_ATCMD
	bool "Thermal switch for query modem RF temp"
	depends on MTK_LEGACY_THERMAL

config MTK_LEGACY_THERMAL_PLATFORM
	string "MTK legacy thermal platform name"
	depends on MTK_LEGACY_THERMAL
```

## drivers/misc/mediatek/vibrator/Kconfig
```kconfig
config MTK_VIBRATOR
	bool "MediaTek Vibrator driver"
	help
	  MediaTek vibrator driver support.
	  Say Y if you have vibrator on your device.
```
